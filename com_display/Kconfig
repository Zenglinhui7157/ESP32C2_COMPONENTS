## com_display/Kconfig
```kconfig
menu "Display Configuration"

choice DISPLAY_TYPE
    prompt "Select display type"
    default DISPLAY_TYPE_ST7789

    config DISPLAY_TYPE_ST7789
        bool "ST7789 SPI Display"
        help
            Select ST7789 display with SPI interface.

    config DISPLAY_TYPE_ST7735S
        bool "ST7735S SPI Display"
        help
            Select ST7735S display with SPI interface.

    config DISPLAY_TYPE_SSD1306
        bool "SSD1306 I2C OLED Display"
        help
            Select SSD1306 display with I2C interface.

    # Add other display types here if needed
    # config DISPLAY_TYPE_XXX
    #     bool "XXX Display"
endchoice

if DISPLAY_TYPE_ST7789

    menu "ST7789 Configuration"

        config ST7789_SPI_HOST
            int "SPI Host (0=SPI1_HOST, 1=SPI2_HOST)"
            range 0 1
            default 1
            help
                SPI host to use for ST7789.

        config ST7789_PIN_MOSI
            int "MOSI Pin"
            default 7
            help
                SPI MOSI pin for ST7789.

        config ST7789_PIN_MISO
            int "MISO Pin"
            default 0
            help
                SPI MISO pin for ST7789 (optional).

        config ST7789_PIN_SCLK
            int "SCLK Pin"
            default 6
            help
                SPI SCLK pin for ST7789.

        config ST7789_PIN_CS
            int "CS Pin"
            default 3
            help
                SPI CS pin for ST7789.

        config ST7789_PIN_DC
            int "DC Pin"
            default 10
            help
                Data/Command pin for ST7789.

        config ST7789_PIN_RST
            int "RST Pin"
            default 4
            help
                Reset pin for ST7789.

        config ST7789_PIN_BL
            int "Backlight Pin"
            default 18
            help
                Backlight control pin for ST7789.

        config ST7789_WIDTH
            int "Display Width"
            default 240
            help
                Width of the display in pixels.

        config ST7789_HEIGHT
            int "Display Height"
            default 240
            help
                Height of the display in pixels.

    endmenu

endif

if DISPLAY_TYPE_ST7735S

    menu "ST7735S Configuration"

        config ST7735S_SPI_HOST
            int "SPI Host (0=SPI1_HOST, 1=SPI2_HOST)"
            range 0 1
            default 1
            help
                SPI host to use for ST7735S.

        config ST7735S_PIN_MOSI
            int "MOSI Pin"
            default 7
            help
                SPI MOSI pin for ST7735S.

        config ST7735S_PIN_MISO
            int "MISO Pin"
            default 0
            help
                SPI MISO pin for ST7735S (optional).

        config ST7735S_PIN_SCLK
            int "SCLK Pin"
            default 6
            help
                SPI SCLK pin for ST7735S.

        config ST7735S_PIN_CS
            int "CS Pin"
            default 3
            help
                SPI CS pin for ST7735S.

        config ST7735S_PIN_DC
            int "DC Pin"
            default 10
            help
                Data/Command pin for ST7735S.

        config ST7735S_PIN_RST
            int "RST Pin"
            default 4
            help
                Reset pin for ST7735S.

        config ST7735S_PIN_BL
            int "Backlight Pin"
            default 18
            help
                Backlight control pin for ST7735S.

        config ST7735S_WIDTH
            int "Display Width"
            default 128
            help
                Width of the display in pixels.

        config ST7735S_HEIGHT
            int "Display Height"
            default 160
            help
                Height of the display in pixels.

    endmenu

endif

if DISPLAY_TYPE_SSD1306

    menu "SSD1306 Configuration"

        config SSD1306_I2C_PORT
            int "I2C Port"
            range 0 1
            default 0
            help
                I2C port to use for SSD1306.

        config SSD1306_PIN_SDA
            int "SDA Pin"
            default 5
            help
                I2C SDA pin for SSD1306.

        config SSD1306_PIN_SCL
            int "SCL Pin"
            default 4
            help
                I2C SCL pin for SSD1306.

        config SSD1306_I2C_ADDR
            hex "I2C Address"
            default 0x3C
            help
                I2C address for SSD1306 (usually 0x3C or 0x3D).

        config SSD1306_WIDTH
            int "Display Width"
            default 128
            help
                Width of the display in pixels.

        config SSD1306_HEIGHT
            int "Display Height"
            default 64
            help
                Height of the display in pixels.

    endmenu

endif

# Add configurations for other display types here

endmenu
```
